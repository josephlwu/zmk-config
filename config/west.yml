## config/west.yml
```yaml
manifest:
  remotes:
    - name: zmkfirmware
      url-base: https://github.com/zmkfirmware
    - name: nicell
      url-base: https://github.com/Nicell
  projects:
#    - name: zmk
#      remote: zmkfirmware
#      revision: main
    - name: zmk
      remote: nicell
      revision: shields/sweet16
      import: app/west.yml
  self:
    path: config
```
